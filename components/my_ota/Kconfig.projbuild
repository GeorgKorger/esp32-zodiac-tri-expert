## components/my_ota/Kconfig.projbuild
```kconfig
menu "my_OTA Configuration"

    config FIRMWARE_UPGRADE_URL
        string "firmware upgrade url endpoint"
        default "https://server:port/firmware.bin"
        help
            URL of server which hosts the firmware
            image.

endmenu
```

## components/wifi_connect/Kconfig.projbuild
```kconfig
menu "Wifi Connection Configuration"

        config WIFI_CONN_MAX_RETRY
            int "Maximum retry"
            default 4
            help
                Set the Maximum retry to avoid station reconnecting to the AP unlimited,
                in case the AP is really inexistent.

        config WIFI_WAIT
            bool "Wait for IP Address"
            default y
            help
                Choose if wifi_connect blocks till IP Address set,

        choice WIFI_SCAN_METHOD
            prompt "WiFi Scan Method"
            default WIFI_SCAN_METHOD_ALL_CHANNEL
            help
                WiFi scan method:

                If "Fast" is selected, scan will end after find SSID match AP.

                If "All Channel" is selected, scan will end after scan all the channel.

            config WIFI_SCAN_METHOD_FAST
                bool "Fast"
            config WIFI_SCAN_METHOD_ALL_CHANNEL
                bool "All Channel"
        endchoice

        menu "WiFi Scan threshold"
            config WIFI_SCAN_RSSI_THRESHOLD
                int "WiFi minimum rssi"
                range -127 0

                default -127
                help
                    The minimum rssi to accept in the scan mode.

            choice WIFI_SCAN_AUTH_MODE_THRESHOLD
                prompt "WiFi Scan auth mode threshold"
                default WIFI_AUTH_OPEN
                help
                    The weakest authmode to accept in the scan mode.

                config WIFI_AUTH_OPEN
                    bool "OPEN"
                config WIFI_AUTH_WEP
                    bool "WEP"
                config WIFI_AUTH_WPA_PSK
                    bool "WPA PSK"
                config WIFI_AUTH_WPA2_PSK
                    bool "WPA2 PSK"
                config WIFI_AUTH_WPA_WPA2_PSK
                    bool "WPA WPA2 PSK"
                config WIFI_AUTH_WPA2_ENTERPRISE
                    bool "WPA2 ENTERPRISE"
                config WIFI_AUTH_WPA3_PSK
                    bool "WPA3 PSK"
                config WIFI_AUTH_WPA2_WPA3_PSK
                    bool "WPA2 WPA3 PSK"
                config WIFI_AUTH_WAPI_PSK
                    bool "WAPI PSK"
            endchoice
        endmenu

        choice WIFI_CONNECT_AP_SORT_METHOD
            prompt "WiFi Connect AP Sort Method"
            default WIFI_CONNECT_AP_BY_SIGNAL
            help
                WiFi connect AP sort method:

                If "Signal" is selected, Sort matched APs in scan list by RSSI.

                If "Security" is selected, Sort matched APs in scan list by security mode.

            config WIFI_CONNECT_AP_BY_SIGNAL
                bool "Signal"
            config WIFI_CONNECT_AP_BY_SECURITY
                bool "Security"
        endchoice


endmenu
```

## main/Kconfig.projbuild
```kconfig
menu "AquaLink Configuration"

    orsource "$IDF_PATH/examples/common_components/env_caps/$IDF_TARGET/Kconfig.env_caps"

    config AQUAL_DEFAULT_POWER
        int "Default Power"
        range 0 100
        default 70
        help
            Default Power Setting when starting and nothing in flash memory.

    config AQUAL_UART_PORT_NUM
        int "UART port number"
        range 0 2 if IDF_TARGET_ESP32 || IDF_TARGET_ESP32S3
        default 2 if IDF_TARGET_ESP32 || IDF_TARGET_ESP32S3
        range 0 1
        default 1
        help
            UART communication port number.
            See UART documentation for available port numbers.

    config AQUAL_UART_BAUD_RATE
        int "UART communication speed"
        range 1200 115200
        default 9600
        help
            UART communication speed.

    config AQUAL_UART_RXD
        int "UART RXD pin number"
        range ENV_GPIO_RANGE_MIN ENV_GPIO_IN_RANGE_MAX
        default 22 if IDF_TARGET_ESP32
        default 8 if !IDF_TARGET_ESP32
        help
            GPIO number for UART RX pin. See UART documentation for more information
            about available pin numbers for UART.

    config AQUAL_UART_TXD
        int "UART TXD pin number"
        range ENV_GPIO_RANGE_MIN ENV_GPIO_OUT_RANGE_MAX
        default 23 if IDF_TARGET_ESP32
        default 9 if !IDF_TARGET_ESP32
        help
            GPIO number for UART TX pin. See UART documentation for more information
            about available pin numbers for UART.

    config AQUAL_UART_RTS
        int "UART RTS pin number"
        range ENV_GPIO_RANGE_MIN ENV_GPIO_OUT_RANGE_MAX
        default 18 if IDF_TARGET_ESP32
        default 10 if !IDF_TARGET_ESP32
        help
            GPIO number for UART RTS pin. This pin is connected to
            ~RE/DE pin of RS485 transceiver to switch direction.
            See UART documentation for more information about available pin
            numbers for UART.

    config AQUAL_TASK_STACK_SIZE
        int "UART task stack size"
        range 1024 16384
        default 3072
        help
            Defines stack size for aql_task. Insufficient stack size can cause crash.

    config AQUAL_WITHOUT_UART
        int "Debug without UART"
        range 0 1
        default 0
        help
            Respond with predefined Responses for ID and Power Command if not connected to tri-expert.

    config WIFI_MAXIMUM_RETRY
        int "Maximum retry"
        default 5
        help
            Set the Maximum retry bevor a break is made

    config WIFI_BREAK_DURATION
        int "Break duration"
        default 5
        help
            Set break duration in Minutes before next Connection attempt

endmenu
```
